## sdk_patch/buildroot/configs/rockchip_rv1126b_ipc_defconfig
```kconfig
#include "base/base.config"
#include "wifibt/bt.config"
#include "wifibt/wireless.config"
#include "chips/rv1126b_aarch64.config"
#include "multimedia/mpp.config"
#include "multimedia/audio.config"
#include "multimedia/camera.config"
# BR2_PACKAGE_ALSA_UCM_CONF is reset to default
BR2_PACKAGE_ALSA_UTILS=y
BR2_PACKAGE_COMMON_ALGORITHM=y
BR2_PACKAGE_ANDROID_ADBD=y
BR2_PACKAGE_ANDROID_ADBD_SECURE=y
BR2_PACKAGE_COMMON_ALGORITHM=y
BR2_PACKAGE_INPUT_EVENT_DAEMON=y
BR2_PACKAGE_IPCWEB_BACKEND=y
BR2_PACKAGE_IPCWEB_BACKEND_USE_RKIPC=y
BR2_PACKAGE_IVA=y
BR2_PACKAGE_IVA_RV1126B=y
BR2_PACKAGE_INPUT_EVENT_DAEMON=y
BR2_PACKAGE_IW=y
# BR2_PACKAGE_LIBMAD is reset to default
BR2_PACKAGE_LIBSNDFILE=y
BR2_PACKAGE_LIBTOOL=y
BR2_PACKAGE_LIBXCRYPT=y
BR2_PACKAGE_NGINX=y
BR2_PACKAGE_NGINX_HTTP_FLV_LIVE=y
BR2_PACKAGE_NGINX_HTTP_GZIP_STATIC_MODULE=y
BR2_PACKAGE_NGINX_HTTP_MP4_MODULE=y
BR2_PACKAGE_NGINX_UPLOAD=y
BR2_PACKAGE_OPENSSH=y
BR2_PACKAGE_PCRE=y
# BR2_PACKAGE_PULSEAUDIO is reset to default
BR2_PACKAGE_RKFSMK=y
BR2_PACKAGE_RKIPC_RV1126B=y
BR2_PACKAGE_ROCKCHIP_TEST=y
BR2_PACKAGE_ROCKCHIP_UVC_APP=y
BR2_PACKAGE_SAMPLES=y
BR2_PACKAGE_SAMPLES_RV1126B=y
BR2_ROOTFS_OVERLAY="board/rockchip/common/base board/rockchip/rv1126b/fs-overlay-ipc/"
```
